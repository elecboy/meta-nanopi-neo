## conf/layer.conf
```bitbake
# We have a conf and classes directory, append to BBPATH
BBPATH .= ":${LAYERDIR}"

# We have a recipes directory, add to BBFILES
BBFILES += "${LAYERDIR}/recipes*/*/*.bb ${LAYERDIR}/recipes*/*/*.bbappend"

BBFILE_COLLECTIONS += "meta-nanopi-neo"
BBFILE_PATTERN_meta-nanopi-neo := "^${LAYERDIR}/"
BBFILE_PRIORITY_meta-nanopi-neo = "60"
LAYERSERIES_COMPAT_meta-nanopi-neo = "warrior"
```

## conf/machine/nanopi-neo-core.conf
```bitbake
#@TYPE: Machine
#@NAME: nanopi-neo
#@DESCRIPTION: Machine configuration for the FriendlyARM NanoPi Neo, based on the Allwinner H3 CPU

require conf/machine/include/sun8i.inc

#PREFERRED_PROVIDER_virtual/kernel = "linux"
#PREFERRED_VERSION_linux-mainline = "4.19.128%"

KERNEL_DEVICETREE = "sun8i-h3-nanopi-neo-core.dtb"
UBOOT_MACHINE = "nanopi_neo_core_defconfig"
PREFERRED_VERSION_u-boot = "2019.01"
PREFERRED_VERSION_u-boot-fw-utils = "2019.01"
PREFERRED_VERSION_u-boot-tools = "2019.01"

DEFAULTTUNE = "cortexa7hf-neon-vfpv4"
MACHINE_EXTRA_RRECOMMENDS += "u-boot-mkimage"
MACHINE_EXTRA_RRECOMMENDS += "nanopi-neo-air-fix udev-rules-nanopi-neo-air python3-rpi-gpio-np"
MACHINE_EXTRA_RRECOMMENDS += "linux-firmware-rtl8723 rtl8723bu rtl8723du kernel-module-8723bu kernel-module-8723du"
MACHINE_EXTRA_RRECOMMENDS += "linux-firmware-rtl8821 kernel-module-8821cu rtl8821cu"
MACHINE_EXTRA_RRECOMMENDS += "linux-firmware-rtl8192ce linux-firmware-rtl8192cu linux-firmware-rtl8192su"
MACHINE_EXTRA_RRECOMMENDS += "linux-firmware-ralink linux-firmware-ath9k linux-firmware-bcm43430 rfkill"
MACHINE_EXTRA_RRECOMMENDS += "openocd"
MACHINE_EXTRA_RRECOMMENDS += "wiringnp"
#MACHINE_EXTRA_RRECOMMENDS += "nrf52-hci-uart"
```
